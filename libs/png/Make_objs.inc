# $id:$
# All objects for building libraries

PNGOBJS	= \
	$(OO)$(PATHSEP)png$(LO)	\
	$(OO)$(PATHSEP)pngset$(LO)	\
	$(OO)$(PATHSEP)pngget$(LO)	\
	$(OO)$(PATHSEP)pngrutil$(LO)	\
	$(OO)$(PATHSEP)pngtrans$(LO)	\
	$(OO)$(PATHSEP)pngread$(LO)	\
	$(OO)$(PATHSEP)pngrio$(LO)	\
	$(OO)$(PATHSEP)pngrtran$(LO)	\
	$(OO)$(PATHSEP)pngmem$(LO)	\
	$(OO)$(PATHSEP)pngerror$(LO)

PNG_OBJS	= \
	$(top_builddir)/libs/png$(PATHSEP)png$(LO)	\
	$(top_builddir)/libs/png$(PATHSEP)pngset$(LO)	\
	$(top_builddir)/libs/png$(PATHSEP)pngget$(LO)	\
	$(top_builddir)/libs/png$(PATHSEP)pngrutil$(LO)	\
	$(top_builddir)/libs/png$(PATHSEP)pngtrans$(LO)	\
	$(top_builddir)/libs/png$(PATHSEP)pngread$(LO)	\
	$(top_builddir)/libs/png$(PATHSEP)pngrio$(LO)	\
	$(top_builddir)/libs/png$(PATHSEP)pngrtran$(LO)	\
	$(top_builddir)/libs/png$(PATHSEP)pngmem$(LO)	\
	$(top_builddir)/libs/png$(PATHSEP)pngerror$(LO)


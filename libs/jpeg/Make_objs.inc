# $id:$
# All objects for building libraries

JPEGOBJS	= \
	$(OO)$(PATHSEP)jcapimin$(LO)	\
	$(OO)$(PATHSEP)jcapistd$(LO)	\
	$(OO)$(PATHSEP)jccoefct$(LO)	\
	$(OO)$(PATHSEP)jccolor$(LO)	\
	$(OO)$(PATHSEP)jcdctmgr$(LO)	\
	$(OO)$(PATHSEP)jchuff$(LO)	\
	$(OO)$(PATHSEP)jcinit$(LO)	\
	$(OO)$(PATHSEP)jcmainct$(LO)	\
	$(OO)$(PATHSEP)jcmarker$(LO)	\
	$(OO)$(PATHSEP)jcmaster$(LO)	\
	$(OO)$(PATHSEP)jcomapi$(LO)	\
	$(OO)$(PATHSEP)jcparam$(LO)	\
	$(OO)$(PATHSEP)jcphuff$(LO)	\
	$(OO)$(PATHSEP)jcprepct$(LO)	\
	$(OO)$(PATHSEP)jcsample$(LO)	\
	$(OO)$(PATHSEP)jctrans$(LO)	\
	$(OO)$(PATHSEP)jdapimin$(LO)	\
	$(OO)$(PATHSEP)jdapistd$(LO)	\
	$(OO)$(PATHSEP)jdatadst$(LO)	\
	$(OO)$(PATHSEP)jdatasrc$(LO)	\
	$(OO)$(PATHSEP)jdcoefct$(LO)	\
	$(OO)$(PATHSEP)jdcolor$(LO)	\
	$(OO)$(PATHSEP)jddctmgr$(LO)	\
	$(OO)$(PATHSEP)jdhuff$(LO)	\
	$(OO)$(PATHSEP)jdinput$(LO)	\
	$(OO)$(PATHSEP)jdmainct$(LO)	\
	$(OO)$(PATHSEP)jdmarker$(LO)	\
	$(OO)$(PATHSEP)jdmaster$(LO)	\
	$(OO)$(PATHSEP)jdmerge$(LO)	\
	$(OO)$(PATHSEP)jdphuff$(LO)	\
	$(OO)$(PATHSEP)jdpostct$(LO)	\
	$(OO)$(PATHSEP)jdsample$(LO)	\
	$(OO)$(PATHSEP)jdtrans$(LO)	\
	$(OO)$(PATHSEP)jerror$(LO)	\
	$(OO)$(PATHSEP)jfdctflt$(LO)	\
	$(OO)$(PATHSEP)jfdctfst$(LO)	\
	$(OO)$(PATHSEP)jfdctint$(LO)	\
	$(OO)$(PATHSEP)jidctflt$(LO)	\
	$(OO)$(PATHSEP)jidctfst$(LO)	\
	$(OO)$(PATHSEP)jidctint$(LO)	\
	$(OO)$(PATHSEP)jidctred$(LO)	\
	$(OO)$(PATHSEP)jmemmgr$(LO)	\
	$(OO)$(PATHSEP)jmemnobs$(LO)	\
	$(OO)$(PATHSEP)jquant1$(LO)	\
	$(OO)$(PATHSEP)jquant2$(LO)	\
	$(OO)$(PATHSEP)jutils$(LO)

JPEG_OBJS	= \
	$(top_builddir)/libs/jpeg$(PATHSEP)jcapimin$(LO)	\
	$(top_builddir)/libs/jpeg$(PATHSEP)jcapistd$(LO)	\
	$(top_builddir)/libs/jpeg$(PATHSEP)jccoefct$(LO)	\
	$(top_builddir)/libs/jpeg$(PATHSEP)jccolor$(LO)	\
	$(top_builddir)/libs/jpeg$(PATHSEP)jcdctmgr$(LO)	\
	$(top_builddir)/libs/jpeg$(PATHSEP)jchuff$(LO)	\
	$(top_builddir)/libs/jpeg$(PATHSEP)jcinit$(LO)	\
	$(top_builddir)/libs/jpeg$(PATHSEP)jcmainct$(LO)	\
	$(top_builddir)/libs/jpeg$(PATHSEP)jcmarker$(LO)	\
	$(top_builddir)/libs/jpeg$(PATHSEP)jcmaster$(LO)	\
	$(top_builddir)/libs/jpeg$(PATHSEP)jcomapi$(LO)	\
	$(top_builddir)/libs/jpeg$(PATHSEP)jcparam$(LO)	\
	$(top_builddir)/libs/jpeg$(PATHSEP)jcphuff$(LO)	\
	$(top_builddir)/libs/jpeg$(PATHSEP)jcprepct$(LO)	\
	$(top_builddir)/libs/jpeg$(PATHSEP)jcsample$(LO)	\
	$(top_builddir)/libs/jpeg$(PATHSEP)jctrans$(LO)	\
	$(top_builddir)/libs/jpeg$(PATHSEP)jdapimin$(LO)	\
	$(top_builddir)/libs/jpeg$(PATHSEP)jdapistd$(LO)	\
	$(top_builddir)/libs/jpeg$(PATHSEP)jdatadst$(LO)	\
	$(top_builddir)/libs/jpeg$(PATHSEP)jdatasrc$(LO)	\
	$(top_builddir)/libs/jpeg$(PATHSEP)jdcoefct$(LO)	\
	$(top_builddir)/libs/jpeg$(PATHSEP)jdcolor$(LO)	\
	$(top_builddir)/libs/jpeg$(PATHSEP)jddctmgr$(LO)	\
	$(top_builddir)/libs/jpeg$(PATHSEP)jdhuff$(LO)	\
	$(top_builddir)/libs/jpeg$(PATHSEP)jdinput$(LO)	\
	$(top_builddir)/libs/jpeg$(PATHSEP)jdmainct$(LO)	\
	$(top_builddir)/libs/jpeg$(PATHSEP)jdmarker$(LO)	\
	$(top_builddir)/libs/jpeg$(PATHSEP)jdmaster$(LO)	\
	$(top_builddir)/libs/jpeg$(PATHSEP)jdmerge$(LO)	\
	$(top_builddir)/libs/jpeg$(PATHSEP)jdphuff$(LO)	\
	$(top_builddir)/libs/jpeg$(PATHSEP)jdpostct$(LO)	\
	$(top_builddir)/libs/jpeg$(PATHSEP)jdsample$(LO)	\
	$(top_builddir)/libs/jpeg$(PATHSEP)jdtrans$(LO)	\
	$(top_builddir)/libs/jpeg$(PATHSEP)jerror$(LO)	\
	$(top_builddir)/libs/jpeg$(PATHSEP)jfdctflt$(LO)	\
	$(top_builddir)/libs/jpeg$(PATHSEP)jfdctfst$(LO)	\
	$(top_builddir)/libs/jpeg$(PATHSEP)jfdctint$(LO)	\
	$(top_builddir)/libs/jpeg$(PATHSEP)jidctflt$(LO)	\
	$(top_builddir)/libs/jpeg$(PATHSEP)jidctfst$(LO)	\
	$(top_builddir)/libs/jpeg$(PATHSEP)jidctint$(LO)	\
	$(top_builddir)/libs/jpeg$(PATHSEP)jidctred$(LO)	\
	$(top_builddir)/libs/jpeg$(PATHSEP)jmemmgr$(LO)	\
	$(top_builddir)/libs/jpeg$(PATHSEP)jmemnobs$(LO)	\
	$(top_builddir)/libs/jpeg$(PATHSEP)jquant1$(LO)	\
	$(top_builddir)/libs/jpeg$(PATHSEP)jquant2$(LO)	\
	$(top_builddir)/libs/jpeg$(PATHSEP)jutils$(LO)


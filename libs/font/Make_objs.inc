# $id:$
# All objects for building libraries

FONTOBJS	= \
	$(OO)$(PATHSEP)ft_cid$(LO)	\
	$(OO)$(PATHSEP)ft_corefont$(LO)	\
	$(OO)$(PATHSEP)ft_font$(LO)	\
	$(OO)$(PATHSEP)ft_hostfont$(LO)	\
	$(OO)$(PATHSEP)ft_pdffont$(LO)	\
	$(OO)$(PATHSEP)ft_truetype$(LO) \
	$(OO)$(PATHSEP)ft_type1$(LO)

FONT_OBJS	= \
	$(top_builddir)/libs/font$(PATHSEP)ft_cid$(LO)	\
	$(top_builddir)/libs/font$(PATHSEP)ft_corefont$(LO)	\
	$(top_builddir)/libs/font$(PATHSEP)ft_font$(LO)	\
	$(top_builddir)/libs/font$(PATHSEP)ft_hostfont$(LO)	\
	$(top_builddir)/libs/font$(PATHSEP)ft_pdffont$(LO)	\
	$(top_builddir)/libs/font$(PATHSEP)ft_truetype$(LO) \
	$(top_builddir)/libs/font$(PATHSEP)ft_type1$(LO)


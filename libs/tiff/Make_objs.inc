# $id:$
# All objects for building libraries

TIFFOBJS	= \
	$(OO)$(PATHSEP)tif_auxx$(LO)		\
	$(OO)$(PATHSEP)tif_close$(LO)	\
	$(OO)$(PATHSEP)tif_codec$(LO)	\
	$(OO)$(PATHSEP)tif_color$(LO)	\
	$(OO)$(PATHSEP)tif_compress$(LO)	\
	$(OO)$(PATHSEP)tif_dir$(LO)		\
	$(OO)$(PATHSEP)tif_dirinfo$(LO)	\
	$(OO)$(PATHSEP)tif_dirread$(LO)	\
	$(OO)$(PATHSEP)tif_dirwrite$(LO)	\
	$(OO)$(PATHSEP)tif_dumpmode$(LO)	\
	$(OO)$(PATHSEP)tif_error$(LO)	\
	$(OO)$(PATHSEP)tif_extension$(LO)	\
	$(OO)$(PATHSEP)tif_fax3$(LO)		\
	$(OO)$(PATHSEP)tif_fax3sm$(LO)	\
	$(OO)$(PATHSEP)tif_flush$(LO)	\
	$(OO)$(PATHSEP)tif_getimage$(LO)	\
	$(OO)$(PATHSEP)tif_jpeg$(LO)		\
	$(OO)$(PATHSEP)tif_luv$(LO)		\
	$(OO)$(PATHSEP)tif_lzw$(LO)		\
	$(OO)$(PATHSEP)tif_next$(LO)		\
	$(OO)$(PATHSEP)tif_ojpeg$(LO)	\
	$(OO)$(PATHSEP)tif_open$(LO)		\
	$(OO)$(PATHSEP)tif_packbits$(LO)	\
	$(OO)$(PATHSEP)tif_predict$(LO)	\
	$(OO)$(PATHSEP)tif_print$(LO)	\
	$(OO)$(PATHSEP)tif_read$(LO)		\
	$(OO)$(PATHSEP)tif_strip$(LO)	\
	$(OO)$(PATHSEP)tif_swab$(LO)		\
	$(OO)$(PATHSEP)tif_tile$(LO)		\
	$(OO)$(PATHSEP)tif_unix$(LO)		\
	$(OO)$(PATHSEP)tif_version$(LO)	\
	$(OO)$(PATHSEP)tif_warning$(LO)	\
	$(OO)$(PATHSEP)tif_write$(LO)	\
	$(OO)$(PATHSEP)tif_zip$(LO)		


TIFF_OBJS	= \
	$(top_builddir)/libs/tiff$(PATHSEP)tif_auxx$(LO)		\
	$(top_builddir)/libs/tiff$(PATHSEP)tif_close$(LO)	\
	$(top_builddir)/libs/tiff$(PATHSEP)tif_codec$(LO)	\
	$(top_builddir)/libs/tiff$(PATHSEP)tif_color$(LO)	\
	$(top_builddir)/libs/tiff$(PATHSEP)tif_compress$(LO)	\
	$(top_builddir)/libs/tiff$(PATHSEP)tif_dir$(LO)		\
	$(top_builddir)/libs/tiff$(PATHSEP)tif_dirinfo$(LO)	\
	$(top_builddir)/libs/tiff$(PATHSEP)tif_dirread$(LO)	\
	$(top_builddir)/libs/tiff$(PATHSEP)tif_dirwrite$(LO)	\
	$(top_builddir)/libs/tiff$(PATHSEP)tif_dumpmode$(LO)	\
	$(top_builddir)/libs/tiff$(PATHSEP)tif_error$(LO)	\
	$(top_builddir)/libs/tiff$(PATHSEP)tif_extension$(LO)	\
	$(top_builddir)/libs/tiff$(PATHSEP)tif_fax3$(LO)		\
	$(top_builddir)/libs/tiff$(PATHSEP)tif_fax3sm$(LO)	\
	$(top_builddir)/libs/tiff$(PATHSEP)tif_flush$(LO)	\
	$(top_builddir)/libs/tiff$(PATHSEP)tif_getimage$(LO)	\
	$(top_builddir)/libs/tiff$(PATHSEP)tif_jpeg$(LO)		\
	$(top_builddir)/libs/tiff$(PATHSEP)tif_luv$(LO)		\
	$(top_builddir)/libs/tiff$(PATHSEP)tif_lzw$(LO)		\
	$(top_builddir)/libs/tiff$(PATHSEP)tif_next$(LO)		\
	$(top_builddir)/libs/tiff$(PATHSEP)tif_ojpeg$(LO)	\
	$(top_builddir)/libs/tiff$(PATHSEP)tif_open$(LO)		\
	$(top_builddir)/libs/tiff$(PATHSEP)tif_packbits$(LO)	\
	$(top_builddir)/libs/tiff$(PATHSEP)tif_predict$(LO)	\
	$(top_builddir)/libs/tiff$(PATHSEP)tif_print$(LO)	\
	$(top_builddir)/libs/tiff$(PATHSEP)tif_read$(LO)		\
	$(top_builddir)/libs/tiff$(PATHSEP)tif_strip$(LO)	\
	$(top_builddir)/libs/tiff$(PATHSEP)tif_swab$(LO)		\
	$(top_builddir)/libs/tiff$(PATHSEP)tif_tile$(LO)		\
	$(top_builddir)/libs/tiff$(PATHSEP)tif_unix$(LO)		\
	$(top_builddir)/libs/tiff$(PATHSEP)tif_version$(LO)	\
	$(top_builddir)/libs/tiff$(PATHSEP)tif_warning$(LO)	\
	$(top_builddir)/libs/tiff$(PATHSEP)tif_write$(LO)	\
	$(top_builddir)/libs/tiff$(PATHSEP)tif_zip$(LO)		

